## Documentation/devicetree/bindings/usb/usbhub_reset.txt
```
* USB HUB reset control driver

Required properties:
- compatible : should be "usbhub-reset".
- uhrst-gpio : USB HUB reset gpio pin.

For example:

usbhub-reset {
	compatible = "usbhub-reset";
	uhrst-gpio = <&gpio4 RK_PD5 GPIO_ACTIVE_HIGH>;
};
```
