// SPDX-License-Identifier: (GPL-2.0+ OR MIT)
/*
 * Copyright (c) 2022 Rockchip Electronics Co., Ltd.
 * Copyright (c) 2022 Radxa Limited
 */

/dts-v1/;

#include "rk3399-rock-pi-4.dtsi"

/ {

	model = "ROCK PI 4B";
	compatible = "rockchip,rockpi","rockchip,rk3399";
};

&wireless_wlan {
	status = "okay";
};

&wireless_bluetooth {
	status = "okay";
};
