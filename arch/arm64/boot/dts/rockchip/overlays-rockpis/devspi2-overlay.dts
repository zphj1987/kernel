/dts-v1/;
/plugin/;

/ {
	model = "ROCK PI S";
	compatible = "rockchip,rockpis-rk3308", "rockchip,rk3308";
	fragment@0 {
		target = <&spi2>;
		__overlay__ {
			max-freq = <50000000>;
			#address-cells = <1>;
			#size-cells = <0>;
			devspi@0 {
				status = "okay";
				reg = <0>;
				compatible ="rockchip,spidev";
				spi-max-frequency = <50000000>;
			};
		};
	};
};
