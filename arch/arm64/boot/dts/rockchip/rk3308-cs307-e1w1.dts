/dts-v1/;

#include "rk3308-cs307.dtsi"

/ {
	model = "Radxa CS307-E1W1";
};

&wireless_wlan {
    wifi_chip_type = "ap6256";
    status = "okay";
};

&wireless_bluetooth {
    status = "okay";
};

&emmc {
	mmc-hs200-1_8v;
	status = "okay";
};