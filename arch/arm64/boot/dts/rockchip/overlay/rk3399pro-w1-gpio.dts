// Definitions for w1-gpio module (without external pullup)
/dts-v1/;
/plugin/;

/ {
	compatible = "radxa,rk3399pro-rockpin10", "rockchip,rk3399pro";

	fragment@0 {
		target-path = "/";
		__overlay__ {

			w1: onewire@0 {
				compatible = "w1-gpio";
				pinctrl-names = "default";
				gpios = <&gpio1 2 0 0xae>; // GPIO1_A2
				status = "okay";
			};
		};
	};
};
