/dts-v1/;
/plugin/;

/ {
	compatible = "radxa,rk3399pro-rockpin10", "rockchip,rk3399pro";

	fragment@0 {
		target = <&uart4>;
		__overlay__ {
			status = "disabled";
		};
	};

	fragment@1 {
		target = <&spi1>;
		__overlay__ {
			status = "disabled";
		};
	};

	fragment@2 {
		target = <&fiq_debugger>;
		__overlay__ {
			status = "okay";
			rockchip,serial-id = <4>;
			pinctrl-names = "default";
			pinctrl-0 = <&uart4_xfer>;
		};
	};
};
