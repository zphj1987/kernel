/dts-v1/;
/plugin/;

/ {
	compatible = "radxa,rk3399pro-rockpin10", "rockchip,rk3399pro";

	fragment@0 {
		target = <&uart2>;
		__overlay__ {
			status = "disabled";
		};
	};

	fragment@1 {
		target = <&fiq_debugger>;
		__overlay__ {
			status = "okay";
			rockchip,serial-id = <2>;
			pinctrl-names = "default";
			pinctrl-0 = <&uart2c_xfer>;
		};
	};
};
