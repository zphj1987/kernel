/dts-v1/;

#include "rk3308-cs307.dtsi"

/ {
	model = "Radxa CS307-E2W3";
};

&wireless_wlan {
	wifi_chip_type = "ap6254";
    status = "okay";
};

&wireless_bluetooth {
    status = "okay";
};

&emmc {
	mmc-hs200-3_3v;
	max-frequency = <50000000>;
	status = "okay";
};